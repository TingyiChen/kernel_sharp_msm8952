## drivers/sharp/Kconfig
```kconfig
#
# SHARP configuration
#

menu "SHARP Device Drivers"

source "drivers/sharp/nfc/Kconfig"
source "drivers/sharp/shdiag/Kconfig"
source "drivers/sharp/shboot/Kconfig"
source "drivers/sharp/shaudio/Kconfig"
source "drivers/sharp/proximity/Kconfig"
source "drivers/sharp/shsensor_hub/ml630q790/Kconfig"

endmenu
```

## drivers/sharp/proximity_light/Kconfig
```kconfig
menu "Proximity & Light Sensor"

config PROX_LIGHT
	bool "enable PROX_LIGHT"
	default n

endmenu
```

## drivers/sharp/tunerdrv/Kconfig
```kconfig
# drivers/sharp/tunerdrv/Kconfig

menu "DTV Tuner Configuration"

config DTV_TUNERDEV
	tristate "set DTV tuner dev."
	default n


endmenu
```

## drivers/sharp/wifi/Kconfig
```kconfig
# drivers/sharp/wifi/Kconfig

menu "Wi-Fi Configuration"

config HEART_BEAT_THRESHOLD_STADEF
    int "WLAN Heart Beat Threshold"
    range 0 10000
    default 0
    help
      The number of beacon misses that the connected AP would be considered as out of range.

endmenu
```
