/* Copyright (c) 2014, The Linux Foundation. All rights reserved.
 *
 * This program is free software; you can redistribute it and/or modify
 * it under the terms of the GNU General Public License version 2 and
 * only version 2 as published by the Free Software Foundation.
 *
 * This program is distributed in the hope that it will be useful,
 * but WITHOUT ANY WARRANTY; without even the implied warranty of
 * MERCHANTABILITY or FITNESS FOR A PARTICULAR PURPOSE.  See the
 * GNU General Public License for more details.
 */

qcom,sharp-8952-2nd {
	qcom,max-voltage-uv = <4320000>;
	qcom,nom-batt-capacity-mah = <2400>;
	qcom,batt-id-kohm = <0>;
	qcom,battery-beta = <3380>;
	qcom,battery-type = "sharp";
	qcom,chg-rslow-comp-c1 = <2944877>;
	qcom,chg-rslow-comp-c2 = <4460302>;
	qcom,chg-rs-to-rslow = <1337950>;
	qcom,chg-rslow-comp-thr = <0xAB>;
	qcom,checksum = <0x36B0>;
	qcom,gui-version = "PMI8950GUI - 2.0.0.16";
	qcom,fg-profile-data = [
		 D9 83 32 7C
		 42 80 AC 75
		 40 83 EA 62
		 F6 7B 56 87
		 20 82 FD 98
		 EE B6 9E C2
		 58 0F 51 82
		 59 80 5A 84
		 A4 78 1F 83
		 73 7A A1 87
		 21 83 5C 82
		 09 93 44 B4
		 30 BB 88 15
		 64 09 E7 59
		 0A 6E 71 FD
		 70 33 0C 47
		 23 41 00 00
		 CC 47 74 3B
		 FD 26 00 00
		 00 00 00 00
		 00 00 00 00
		 CB 72 B7 71
		 56 77 A7 7A
		 A4 7C 76 70
		 BC 75 6B 79
		 90 7C 56 70
		 DD 58 76 A2
		 23 CE 60 96
		 4D A0 71 0C
		 28 00 FF 36
		 F0 11 30 03
		 00 00 00 0C
	];
};
