/* Copyright (c) 2016, The Linux Foundation. All rights reserved.
 *
 * This program is free software; you can redistribute it and/or modify
 * it under the terms of the GNU General Public License version 2 and
 * only version 2 as published by the Free Software Foundation.
 *
 * This program is distributed in the hope that it will be useful,
 * but WITHOUT ANY WARRANTY; without even the implied warranty of
 * MERCHANTABILITY or FITNESS FOR A PARTICULAR PURPOSE.  See the
 * GNU General Public License for more details.
 */

&soc {
	sharp,shdisp_panel_hayabusa {
		compatible = "sharp,shdisp_hayabusa";
		status = "disable";
		hayabusa_rst_gpio = <&msm_gpio 0 0>;
		hayabusa_vdd_gpio = <&msm_gpio 66 0>;
		hayabusa_mipi_err_gpio = <&msm_gpio 37 0>;
		interrupts = <37 0>;
		interrupt-parent = <&msm_gpio>;
		clocks = <&clock_gcc clk_bb_clk2>;
		clock-names = "bbclk2";
	};
};

