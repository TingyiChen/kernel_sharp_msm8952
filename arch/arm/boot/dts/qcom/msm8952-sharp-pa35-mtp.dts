/*
 * Copyright (c) 2015, The Linux Foundation. All rights reserved.
 *
 * This program is free software; you can redistribute it and/or modify
 * it under the terms of the GNU General Public License version 2 and
 * only version 2 as published by the Free Software Foundation.
 *
 * This program is distributed in the hope that it will be useful,
 * but WITHOUT ANY WARRANTY; without even the implied warranty of
 * MERCHANTABILITY or FITNESS FOR A PARTICULAR PURPOSE.  See the
 * GNU General Public License for more details.
 */

/dts-v1/;

#include "msm8952-mtp.dtsi"
#include "sharp-common.dtsi"
/* SH_CAMERA_DRIVER-> */
#include "msm8952-camera-sensor-13M-5M.dtsi"
/* SH_CAMERA_DRIVER<- */
#include "sharp-pa35.dtsi"

/ {
	model = "sharp pa35";
	compatible = "qcom,sharp-pa35", "qcom,msm8952-mtp", "qcom,msm8952", "qcom,mtp";
	qcom,board-id= <28 0>;
};
