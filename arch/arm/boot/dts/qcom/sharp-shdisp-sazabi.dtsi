/* Copyright (c) 2014, The Linux Foundation. All rights reserved.
 *
 * This program is free software; you can redistribute it and/or modify
 * it under the terms of the GNU General Public License version 2 and
 * only version 2 as published by the Free Software Foundation.
 *
 * This program is distributed in the hope that it will be useful,
 * but WITHOUT ANY WARRANTY; without even the implied warranty of
 * MERCHANTABILITY or FITNESS FOR A PARTICULAR PURPOSE.  See the
 * GNU General Public License for more details.
 */

&soc {
	/*---------------------*/
	/* sazabi irq          */
	/*---------------------*/
	sharp,shdisp_panel_sazabi {
		compatible = "sharp,shdisp_sazabi";
		status = "disable";
		sazabi_vddi_gpio = <&msm_gpio 66 0>;
		sazabi_vdda-supply = <&pm8950_l10>;
		sazabi_rst_gpio = <&msm_gpio 0 0>;
		sazabi_mipierr_gpio = <&msm_gpio 37 0>;
		interrupts = <37 0>;
		interrupt-parent = <&msm_gpio>;
	};
};

